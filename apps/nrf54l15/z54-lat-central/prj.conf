## CMakeLists.txt
```
cmake_minimum_required(VERSION 3.20.0)
find_package(Zephyr REQUIRED HINTS $ENV{ZEPHYR_BASE})
project(z54_lat_central)
target_sources(app PRIVATE src/main.c)
target_sources_ifdef(CONFIG_BT_CTLR_FSU_EVENTFILL_DIAG app PRIVATE src/eventfill.c)
```

## Kconfig
```
config APP_HB_SENDER
	bool "Periodic safety-heartbeat sender (§14.9 DRAFT)"
	default n
	select GPIO
	help
	  Sends fixed-period heartbeats {epoch u32, seq u32} to the peripheral's
	  dedicated heartbeat characteristic, decoupled from the RTT ping/pong
	  (acks are diagnostics only). Fresh frame per period — a busy TX path
	  drops the stale heartbeat rather than queueing it. Button sw0 SUPPRESSES
	  sending one-way until reboot (fault-injection test hook — the task keeps
	  running); the "alive" GPIO distinguishes suppressed sending from power
	  loss on the logic analyzer.

if APP_HB_SENDER

config APP_HB_PERIOD_MS
	int "Heartbeat period (ms)"
	default 20
	range 5 1000

endif # APP_HB_SENDER

config APP_LOAD_RAMP
	bool "Latency-under-load ramp: pings + self-stepping bulk load"
	default n
	help
	  Keeps the serialized RTT pings running and adds a rate-limited bulk
	  stream to the peripheral's bulk-sink characteristic, stepping the
	  target rate 0/25/50/75/100/125/150 KB/s every 60 s, logging LOADRAMP
	  markers. One build measures a whole ramp.

config APP_LOAD_RAMP_HIGH
	bool "Load ramp: high-load stages 0/140/150/160/170/180/190 KB/s"
	depends on APP_LOAD_RAMP
	default n
	help
	  Replaces the ramp's stages with 0/140/150/160/170/180/190 KB/s (60 s
	  each), to probe stop-signal latency around and above the link's bulk
	  ceiling (e.g. FSU off vs on at 7.5 ms). Default off: the standard ramp.

config APP_LOAD_POLITE
	bool "Load ramp: completion-pace bulk to 1-outstanding (mitigation arm)"
	depends on APP_LOAD_RAMP
	default n
	help
	  Mitigation arm of the latency-under-load ramp. Instead of fire-and-forget
	  bulk writes, gate each bulk write on the previous write's completion
	  callback via a 1-permit semaphore, keeping at most one bulk write in the
	  TX path so the stop-signal ping is not stuck behind a deep bulk backlog.

config APP_TPUT_BLAST
	bool "Throughput blast mode (replaces RTT pings with max-payload writes)"
	default n

config APP_TPUT_PAYLOAD_CAP
	int "Phase-A diagnosis: cap blast payload bytes (0 = off)"
	default 0
	range 0 247

config APP_SCI_INTERVAL_125US
	int "SDC cell S1: request this connection interval (125 us units; 0 = off)"
	default 0
	range 0 480

config APP_SDC6X_DELAY_S
	int "Delay before 6.x feature requests (SCI/FSU) after subscribe (s)"
	default 3
	help
	  Must exceed any expected GAP auto connection-parameter update:
	  ull_conn_update_parameters resets the tifs fields to defaults, so an
	  update landing after FSU adoption silently reverts the spacing.

config APP_FSU_MIN_US
	int "SDC cell F1: FSU requested minimum frame space (us)"
	default 0
	range 0 10000

config APP_FSU_MAX_US
	int "SDC cell F1: FSU requested maximum frame space (us; 0 = no FSU request)"
	default 0
	range 0 10000

config APP_GO_FAST_1MS
	bool "§6.1 positive control: drop to 2M/1ms (pin_interval=false)"
	default n

config APP_CONN_INT_UNITS
	int "Pinned connection interval (1.25 ms units): 6=7.5ms 12=15ms 24=30ms"
	default 6
	range 6 3200

source "Kconfig.zephyr"
```

## prj.conf
```kconfig
CONFIG_BT=y
CONFIG_BT_CENTRAL=y
CONFIG_BT_DEVICE_NAME="z54-lat-central"
CONFIG_BT_GATT_CLIENT=y
CONFIG_BT_USER_PHY_UPDATE=y
CONFIG_BT_USER_DATA_LEN_UPDATE=y
CONFIG_BT_CTLR_PHY_2M=y
CONFIG_BT_CTLR_DATA_LENGTH_MAX=251
CONFIG_HEAP_MEM_POOL_SIZE=4096
CONFIG_MAIN_STACK_SIZE=2048
CONFIG_PRINTK=y
CONFIG_LOG=y
```

## bench.conf
```kconfig
# §14.9 watchdog-bench overlay — NOT part of the default build.
# Enabling the HB sender measurably shifts the ping RTT distribution
# (observed mean ~11.9 -> ~8.9 ms), so latency baselines must be taken
# WITHOUT this fragment. Build with:
#   west build -- -DEXTRA_CONF_FILE=bench.conf
CONFIG_APP_HB_SENDER=y
```

## hh-fsu150.conf
```kconfig
# GATT matched FSU-OFF arm (open): identical feature package to hh-fsu52.conf,
# only the requested frame space differs (150 vs 52 us) -> clean FSU isolation,
# mirroring CoC's open-nofsu. Use WITH tput-open.conf;fsu-open.conf.
# See REPRODUCE.md GATT confound note + tools/check_matched_pair.py.
CONFIG_APP_FSU_MIN_US=150
CONFIG_APP_FSU_MAX_US=150
```

## hh-fsu52.conf
```kconfig
CONFIG_APP_FSU_MIN_US=52
CONFIG_APP_FSU_MAX_US=52
```

## hh-sdc-nofsu.conf
```kconfig
# GATT matched FSU-OFF arm (SDC): identical to hh-sdc-fsu.conf EXCEPT the requested
# frame space is 150 (not 52) us -> clean FSU isolation. Responder (sink) keeps
# sdc-fsu.conf so the only variable is the central's requested spacing.
CONFIG_BT_LE_EXTENDED_FEAT_SET=y
CONFIG_BT_FRAME_SPACE_UPDATE=y
CONFIG_BT_CTLR_FRAME_SPACE_UPDATE=y
CONFIG_BT_CTLR_SDC_ENABLE_LOWEST_FRAME_SPACE=y
CONFIG_BT_CTLR_SDC_EXTENDED_FEAT_MAX_REMOTE_PAGE=1
CONFIG_APP_FSU_MIN_US=150
CONFIG_APP_FSU_MAX_US=150
CONFIG_APP_SDC6X_DELAY_S=12
CONFIG_BT_GAP_AUTO_UPDATE_CONN_PARAMS=n
CONFIG_BT_CTLR_SDC_MAX_CONN_EVENT_LEN_DEFAULT_OVERRIDE=y
CONFIG_BT_CTLR_SDC_MAX_CONN_EVENT_LEN_DEFAULT=50000
```

## loadramp.conf
```kconfig
# nRF54 latency-under-load ramp: pings + stepping bulk (buffers big enough
# for 244 B bulk writes; DLE for realistic air use).
CONFIG_APP_LOAD_RAMP=y
CONFIG_BT_BUF_ACL_TX_SIZE=251
CONFIG_BT_BUF_ACL_RX_SIZE=251
CONFIG_BT_BUF_ACL_TX_COUNT=10
CONFIG_BT_BUF_EVT_RX_COUNT=16
CONFIG_BT_L2CAP_TX_MTU=247
CONFIG_BT_AUTO_DATA_LEN_UPDATE=y
```

## m0-f100.conf
```kconfig
# M0 sweep step: request [100..150] us
CONFIG_APP_FSU_MIN_US=100
CONFIG_APP_FSU_MAX_US=150
```

## src/eventfill.c
```c
/*
 * Event-fill reporter (bench-only): prints the patched open controller's per-connection-event
 * transaction histogram every 2 s, so packets per event can be read alongside throughput.
 * Compiled only when CONFIG_BT_CTLR_FSU_EVENTFILL_DIAG=y (see CMakeLists.txt); normal builds
 * of this app are unaffected. The counters are defined by the fsu-m0 controller patch 0015.
 *
 * Output, per 2 s window:  RPT pe: events=<n> mean=<m.mm> mode=<k> max=<k> | <k>:<count> ...
 * where <k> is transactions in a closed connection event (in GATT echo duplex, one transaction
 * = one central packet + the peripheral's reply).
 */
#include <zephyr/kernel.h>
#include <zephyr/sys/printk.h>

extern volatile uint16_t lll_conn_q2_pe[64];
extern volatile uint16_t lll_conn_q2_pe_max;
extern volatile uint32_t lll_conn_q2_events;

#define EVENTFILL_REPORT_MS 2000

static void eventfill_fn(void *a, void *b, void *c)
{
	ARG_UNUSED(a); ARG_UNUSED(b); ARG_UNUSED(c);
	static uint16_t prev[64];
	uint32_t prev_ev = lll_conn_q2_events;

	for (int i = 0; i < 64; i++) {
		prev[i] = lll_conn_q2_pe[i];
	}
	while (1) {
		k_msleep(EVENTFILL_REPORT_MS);
		uint16_t now[64];
		uint32_t ev = lll_conn_q2_events, d_ev = ev - prev_ev;
		uint64_t pkts = 0;
		uint16_t best = 0;
		int mode = 0;

		for (int i = 0; i < 64; i++) {
			now[i] = lll_conn_q2_pe[i];
			uint16_t d = now[i] - prev[i];

			pkts += (uint64_t)i * d;
			if (d > best) {
				best = d;
				mode = i;
			}
		}
		uint32_t mean_x100 = d_ev ? (uint32_t)(pkts * 100 / d_ev) : 0;

		printk("RPT pe: events=%u mean=%u.%02u mode=%d max=%u |", d_ev, mean_x100 / 100,
		       mean_x100 % 100, mode, lll_conn_q2_pe_max);
		for (int i = 0; i < 64; i++) {
			uint16_t d = now[i] - prev[i];

			if (d) {
				printk(" %d:%u", i, d);
			}
			prev[i] = now[i];
		}
		printk("\n");
		prev_ev = ev;
	}
}

K_THREAD_DEFINE(eventfill_tid, 1024, eventfill_fn, NULL, NULL, NULL, 12, 0, 1000);
```
