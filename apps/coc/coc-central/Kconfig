## apps/coc/coc-duplex-central/Kconfig
```kconfig
# CoC central FSU target: request [MIN..MAX] frame space after the channel is up.
# In-band control uses MIN=MAX=150 (FSU procedure runs, grants no reduction) so the
# ONLY variable between arms is the granted spacing (52 vs 150 us).
config APP_FSU_MIN_US
	int "FSU requested minimum frame space (us)"
	default 0
	range 0 10000
config APP_FSU_MAX_US
	int "FSU requested maximum frame space (us; 0 = no FSU request)"
	default 0
	range 0 10000
config APP_AUTO_FSU
	bool "Auto-request FSU once the CoC channel is up"
	depends on BT_FRAME_SPACE_UPDATE
	default n
config APP_CONN_INT_UNITS
	int "Pinned connection interval (1.25 ms units): 6=7.5ms 12=15ms 20=25ms"
	default 6
	range 6 3200

config APP_DUPLEX_SDU_SIZE
	int "Downlink SDU size in bytes (default 480 = two LL packets at DLE 251)"
	default 480
	range 23 512
	help
	  Size of the SDUs the central's downlink sender blasts. The sink's uplink
	  uses 244-byte SDUs (one LL packet each); other values are for diagnosing
	  the duplex split.

config APP_TX_POOL_COUNT
	int "Downlink SDU pool depth (default 16 = the shallow-pool duplex fix)"
	default 16
	range 1 128
	help
	  Number of SDU buffers the central's downlink sender may have in flight.
	  16 is the documented duplex fix (keeps the queue shallow so the peer's
	  uplink is not starved); other values are for diagnosing the duplex split.

config APP_CREDIT_TRACE
	bool "Print a 1 s CTRACE line of TX credit/queue state (diagnostic)"
	help
	  Samples the CoC channel's TX credits, its L2CAP queue and the controller's
	  free ACL buffers every APP_CREDIT_TRACE_US and prints their distribution.
	  Off by default (images unchanged).

config APP_CREDIT_TRACE_US
	int "CTRACE sample period (us)"
	default 500
	depends on APP_CREDIT_TRACE

source "Kconfig.zephyr"
```

## apps/eatt/eattlat-central/Kconfig
```kconfig
config APP_HB_SENDER
	bool "Periodic safety-heartbeat sender (§14.9 DRAFT)"
	default n
	select GPIO
	help
	  Sends fixed-period heartbeats {epoch u32, seq u32} to the peripheral's
	  dedicated heartbeat characteristic, decoupled from the RTT ping/pong
	  (acks are diagnostics only). Fresh frame per period — a busy TX path
	  drops the stale heartbeat rather than queueing it. Button sw0 SUPPRESSES
	  sending one-way until reboot (fault-injection test hook — the task keeps
	  running); the "alive" GPIO distinguishes suppressed sending from power
	  loss on the logic analyzer.

if APP_HB_SENDER

config APP_HB_PERIOD_MS
	int "Heartbeat period (ms)"
	default 20
	range 5 1000

endif # APP_HB_SENDER

config APP_LOAD_RAMP
	bool "Latency-under-load ramp: pings + self-stepping bulk load"
	default n
	help
	  Keeps the serialized RTT pings running and adds a rate-limited bulk
	  stream to the peripheral's bulk-sink characteristic, stepping the
	  target rate 0/25/50/75/100/125/150 KB/s every 60 s, logging LOADRAMP
	  markers. One build measures a whole ramp.

config APP_LOAD_POLITE
	bool "Load ramp: completion-pace bulk to 1-outstanding (mitigation arm)"
	depends on APP_LOAD_RAMP
	default n
	help
	  Mitigation arm of the latency-under-load ramp. Instead of fire-and-forget
	  bulk writes, gate each bulk write on the previous write's completion
	  callback via a 1-permit semaphore, keeping at most one bulk write in the
	  TX path so the stop-signal ping is not stuck behind a deep bulk backlog.

config APP_TPUT_BLAST
	bool "Throughput blast mode (replaces RTT pings with max-payload writes)"
	default n

config APP_TPUT_PAYLOAD_CAP
	int "Phase-A diagnosis: cap blast payload bytes (0 = off)"
	default 0
	range 0 247

config APP_SCI_INTERVAL_125US
	int "SDC cell S1: request this connection interval (125 us units; 0 = off)"
	default 0
	range 0 480

config APP_SDC6X_DELAY_S
	int "Delay before 6.x feature requests (SCI/FSU) after subscribe (s)"
	default 3
	help
	  Must exceed any expected GAP auto connection-parameter update:
	  ull_conn_update_parameters resets the tifs fields to defaults, so an
	  update landing after FSU adoption silently reverts the spacing.

config APP_FSU_MIN_US
	int "SDC cell F1: FSU requested minimum frame space (us)"
	default 0
	range 0 10000

config APP_FSU_MAX_US
	int "SDC cell F1: FSU requested maximum frame space (us; 0 = no FSU request)"
	default 0
	range 0 10000

config APP_GO_FAST_1MS
	bool "§6.1 positive control: drop to 2M/1ms (pin_interval=false)"
	default n

config APP_CONN_INT_UNITS
	int "Pinned connection interval (1.25 ms units): 6=7.5ms 12=15ms 24=30ms"
	default 6
	range 6 3200

source "Kconfig.zephyr"
```
